## firmware/main/Kconfig.projbuild
```kconfig
menu "SmartRelay Runtime Config"

choice SR_LOG_PROFILE
    prompt "Chip log profile"
    default SR_LOG_PROFILE_DEV
    help
        Select logging detail level for development or production.

config SR_LOG_PROFILE_DEV
    bool "Development mode (verbose logs)"
    help
        Print detailed provisioning and MQTT command logs for debugging.

config SR_LOG_PROFILE_PROD
    bool "Production mode (core logs only)"
    help
        Keep only key startup/state/error logs for performance and security.

endchoice

config SR_FW_VERSION
    string "Firmware version"
    default "1.0.7"
    help
        Runtime reported firmware version string.

choice SR_RELAY_TRIGGER_LEVEL
    prompt "Relay trigger level"
    default SR_RELAY_ACTIVE_LOW
    help
        Select relay module active level.

config SR_RELAY_ACTIVE_LOW
    bool "Active low (LOW=ON)"
    help
        Typical for many relay boards with low-level trigger jumper.

config SR_RELAY_ACTIVE_HIGH
    bool "Active high (HIGH=ON)"
    help
        Use this for relay boards configured as high-level trigger.

endchoice

config SR_MQTT_HOST
    string "MQTT host"
    default "127.0.0.1"
    help
        MQTT broker hostname or IP.

config SR_MQTT_PORT
    int "MQTT port"
    range 1 65535
    default 1883
    help
        MQTT broker TCP port.

config SR_MQTT_USER
    string "MQTT username"
    default "SmartRelay"
    help
        MQTT authentication username.

config SR_MQTT_PASS
    string "MQTT password"
    default "change_me"
    help
        MQTT authentication password.

config SR_VERBOSE_MQTT_RX_LOG
    bool "Verbose MQTT RX logs (debug only)"
    default n
    help
        Print per-message MQTT enqueue/dequeue and payload logs.
        Keep disabled for stress tests to avoid UART bottleneck.

endmenu
```

## firmware/sdkconfig.defaults
```kconfig
# SmartRelay — ESP-IDF v5.5.4（ESP32-C3 + WiFi + NimBLE + MQTT）
CONFIG_IDF_TARGET="esp32c3"

# 与常见 4MB Flash 硬件一致（避免 header 2MB / 芯片 4MB 告警）
CONFIG_ESPTOOLPY_FLASHSIZE_4MB=y
CONFIG_ESPTOOLPY_FLASHSIZE="4MB"

CONFIG_LOG_DEFAULT_LEVEL_INFO=y
CONFIG_ESP_CONSOLE_USB_SERIAL_JTAG=y
CONFIG_ESP_MAIN_TASK_STACK_SIZE=8192
CONFIG_MAIN_TASK_STACK_SIZE=8192

CONFIG_ESP_WIFI_STATIC_RX_BUFFER_NUM=10
CONFIG_ESP_WIFI_DYNAMIC_RX_BUFFER_NUM=32

CONFIG_BT_ENABLED=y
CONFIG_BT_NIMBLE_ENABLED=y
CONFIG_BT_NIMBLE_MAX_CONNECTIONS=3
CONFIG_BT_NIMBLE_ROLE_PERIPHERAL=y

CONFIG_ESP_COEX_SW_COEXIST_ENABLE=y

CONFIG_MBEDTLS_CERTIFICATE_BUNDLE=y
CONFIG_ESP_HTTPS_OTA_ALLOW_HTTP=y

CONFIG_PARTITION_TABLE_CUSTOM=y
CONFIG_PARTITION_TABLE_CUSTOM_FILENAME="partitions.csv"
CONFIG_PARTITION_TABLE_FILENAME="partitions.csv"

# SmartRelay runtime config (override per environment)
CONFIG_SR_LOG_PROFILE_DEV=y
CONFIG_SR_FW_VERSION="1.0.7"
CONFIG_SR_RELAY_ACTIVE_LOW=y
CONFIG_SR_MQTT_HOST="127.0.0.1"
CONFIG_SR_MQTT_PORT=1883
CONFIG_SR_MQTT_USER="SmartRelay"
CONFIG_SR_MQTT_PASS="change_me"
# CONFIG_SR_VERBOSE_MQTT_RX_LOG is not set
```
